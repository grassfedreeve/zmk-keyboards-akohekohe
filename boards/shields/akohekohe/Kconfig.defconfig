## boards/shields/akohekohe/Kconfig.defconfig
```kconfig
# Copyright (c) 2024 The ZMK Contributors
# SPDX-License-Identifier: MIT

if SHIELD_AKOHEKOHE

config ZMK_KEYBOARD_NAME
    default "akohekohe"

endif
```

## boards/shields/akohekohe/Kconfig.shield
```kconfig
# Copyright (c) 2024 The ZMK Contributors
# SPDX-License-Identifier: MIT

config SHIELD_AKOHEKOHE
   def_bool $(shields_list_contains,akohekohe)
```
